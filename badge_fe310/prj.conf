## CMakeLists.txt
```
include($ENV{ZEPHYR_BASE}/cmake/app/boilerplate.cmake NO_POLICY_SCOPE)
project(NONE)

execute_process(
  COMMAND git log -1 --format=%h
  WORKING_DIRECTORY ${CMAKE_SOURCE_DIR}
  OUTPUT_VARIABLE GIT_COMMIT_HASH
  OUTPUT_STRIP_TRAILING_WHITESPACE
)

add_definitions(-DCOMMIT="${GIT_COMMIT_HASH}")

target_sources(app PRIVATE src/main.c src/eeprom.c src/epd.c src/spi-badge.c)
```

## sample.yaml
```
sample:
  name: FE310 Epaper example
  platforms: hifive1
```

## prj.conf
```kconfig
CONFIG_RISCV32=y
CONFIG_ARCH="riscv32"
CONFIG_SOC_SERIES="fe310"
CONFIG_SOC_FAMILY="riscv-privilege"
CONFIG_BOARD="hifive1"

CONFIG_SPI=y
CONFIG_SPI_FE310=y
CONFIG_SPI_INIT_PRIORITY=70
CONFIG_SPI_0=y
CONFIG_SPI_0_NAME="SPI_0"
CONFIG_SPI_0_IRQ_PRI=1
CONFIG_SPI_0_DEFAULT_CFG=0x80
CONFIG_SPI_0_DEFAULT_BAUD_RATE=500000
CONFIG_SPI_LEGACY_API=n

CONFIG_I2C=y
CONFIG_I2C_SC18IS600=y
CONFIG_I2C_INIT_PRIORITY=60
CONFIG_I2C_0=y
CONFIG_I2C_0_NAME="I2C_0"
CONFIG_I2C_0_DEFAULT_CFG=0x0
CONFIG_I2C_0_IRQ_PRI=1

CONFIG_PINMUX=y
CONFIG_PINMUX_NAME="PINMUX"
CONFIG_PINMUX_INIT_PRIORITY=45
CONFIG_PINMUX_FE310=y
CONFIG_PINMUX_FE310_0_NAME="pinmux0"
```

## src/main.c
```c
/*
 * Copyright (c) 2017 Antmicro <www.antmicro.com>
 *
 * SPDX-License-Identifier: Apache-2.0
 */

#include <zephyr.h>
#include <string.h>
#include <misc/printk.h>
#include <device.h>
#include <spi.h>
#include <i2c.h>
#include "gpio_fe310.h"
#include "spi-badge.h"
#include "epd.h"
#include "eeprom.h"
#include "risc-v-logo.h"

#define POWER_SEQ_GPIO 0x13 /* gpio 19 */

extern void __soc_enter_deep_sleep(void);

/* We use global buffers so they are allocated in the data section */
unsigned char uncompressed_image[2400];
unsigned char eeprom_img_buffer[2400];

void power_seq_on(void)
{
	GPIO_REG(GPIO_OUTPUT_EN) |= (0x1 << POWER_SEQ_GPIO);
	GPIO_REG(GPIO_OUTPUT_VAL) |= (0x1 << POWER_SEQ_GPIO);
}

void power_seq_off(void)
{
	GPIO_REG(GPIO_OUTPUT_EN) |= (0x1 << POWER_SEQ_GPIO);
	GPIO_REG(GPIO_OUTPUT_VAL) &= ~(0x1 << POWER_SEQ_GPIO);
}


void main(void)
{
	struct EPD_configuration epd;
	struct device *spi_dev;
	struct device *i2c_dev;
	struct spi_config spi_conf;

	unsigned short eeprom_img_size;
	int ret;

	unsigned char *draw_buffer;

	power_seq_on();
	k_sleep(3000);

	printk("\nDate of compilation: %s\n", __DATE__);
	printk("Last commit hash: %s\n\n", COMMIT);

	spi_dev = device_get_binding(CONFIG_SPI_0_NAME);

	if (!spi_dev) {
		printk("Failed to bind SPI driver\n");
	}

	spi_conf.dev = spi_dev,
	spi_conf.frequency = 8000000UL,
	spi_conf.operation = (8 << 5),
	spi_conf.slave = LCD_CS,
	spi_conf.cs = NULL,

	i2c_dev = device_get_binding(CONFIG_I2C_0_NAME);
	if (!i2c_dev) {
		printk("Failed to bind I2C driver\n");
	}

	/* generic*/
	epd.size = EPD_2_0;
	epd.middle_scan = true;

	/* display specific */
	epd.lines_per_display = 96;
	epd.dots_per_line = 200;
	epd.bytes_per_line = 200 / 8;
	epd.bytes_per_scan = 96 / 4;
	epd.pre_border_byte = true;
	epd.border_byte = EPD_BORDER_BYTE_NONE;

	epd.stage_repetitions = 10;

	/* because our display has middle_scan set */
	epd.line_buffer_size = 2 * epd.bytes_per_line + epd.bytes_per_scan + 3;

	{
		/* line_buffer_size + 4096*/
		static unsigned char _lb[400 + 96/4 + 3 + 4096];

		epd.line_buffer =  (unsigned char *)&_lb;
	}

	/* clear line buffer */
	memset(epd.line_buffer, 0x00, epd.line_buffer_size);

	epd_gpio_init();
	printk("(Re)initializing devices\n");
	spi_setup_for_epd(&spi_conf);
	epd_init(&spi_conf);

	epd_clear(&epd);

	printk("Reading eeprom\n");
	ret = read_image_from_eeprom(i2c_dev, eeprom_img_buffer);
	eeprom_img_size = (unsigned short)ret;

	if(ret > 0) {
		printk("Uncompressing image from eeprom\n");
		uncompress_eeprom_image(uncompressed_image,
					eeprom_img_buffer,
					eeprom_img_size);
		draw_buffer = uncompressed_image;
	} else {
		/* if there is no image in the EEPROM
		 * use the default one */
		printk("Using default image \n");
		draw_buffer = riscv_logo_bits;
	}

	printk("Drawing\n");
	/* Drawing image */
	spi_setup_for_epd(&spi_conf);
	epd_image_0(&epd, draw_buffer);

	printk("De-initializing LCD\n");
	/* Power off LCD */
	epd_poweroff();

	/* We cannot leave CS for LCD, so setup for i2c */
	i2c_configure(i2c_dev, 0);

	/* Discharge the pumps */
	epd_discharge();

	/* Force power off through the power sequencer */
	printk("Powering off\n");
	k_sleep(10);
	power_seq_off();

	/* When battery powered we will not get here.
	 * On USB we will print dots to mark that the
	 * device is working. */

	while (1) {
		printk(".");
		k_sleep(1000);
	}

}
```

## src/eeprom.c
```c
/*
 * Copyright (c) 2017 Antmicro <www.antmicro.com>
 *
 * SPDX-License-Identifier: Apache-2.0
 */

#include <zephyr.h>
#include <string.h>
#include <misc/printk.h>
#include <device.h>
#include <i2c.h>

#include "eeprom.h"

static inline int eeprom_burst_read(struct device *dev, u16_t dev_addr,
			unsigned char *start_addr, unsigned char *buf,
			unsigned char num_bytes)
{
	const struct i2c_driver_api *api = dev->driver_api;
	struct i2c_msg msg[2];

	msg[0].buf = start_addr;
	msg[0].len = 2;
	msg[0].flags = I2C_MSG_WRITE;

	msg[1].buf = buf;
	msg[1].len = num_bytes;
	msg[1].flags = I2C_MSG_RESTART | I2C_MSG_READ | I2C_MSG_STOP;

	return api->transfer(dev, msg, 2, dev_addr);

}

int read_image_from_eeprom(struct device *i2c_dev,
			   unsigned char *eeprom_img_buf)
{
	/* Start at adress 0x0000, MSB first */
	unsigned char start_adress[] = {0x00, 0x00};
	unsigned int magic;
	const int chunk_size = 64;
	int bytes_to_read;
	unsigned short eeprom_img_size = 0;

	/* Read 4 bytes and check for 0x0deadbeef */
	bytes_to_read = 4;
	eeprom_burst_read(i2c_dev, I2C_EEPROM_ADDR,
			start_adress, (unsigned char *) &magic, bytes_to_read);

	printk("Magic bytes in eeprom: %08x\n", magic);
	if (magic != 0xdeadbeef) {
		printk("No deadbeef\n");
		return -1;
	}
	/* Set next unread adress */
	start_adress[1] = 0x04;
	/* Read 2 bytes, should be size of image */
	bytes_to_read = 2;
	eeprom_burst_read(i2c_dev, I2C_EEPROM_ADDR,
			start_adress, (unsigned char *) &eeprom_img_size,
		       	bytes_to_read);
	printk("Compressed eeprom image size: %d\n", eeprom_img_size);

	for (int bytes_read = 6; bytes_read < eeprom_img_size;
			bytes_read += bytes_to_read) {
		bytes_to_read = (eeprom_img_size - bytes_read);
		if (bytes_to_read > chunk_size)
			bytes_to_read = chunk_size;
		start_adress[1] = (bytes_read & 0xFF);
		start_adress[0] = (bytes_read >> 8) & 0xFF;
		eeprom_burst_read(i2c_dev, I2C_EEPROM_ADDR,
			start_adress, (eeprom_img_buf + bytes_read),
			bytes_to_read);
	}

	return eeprom_img_size;
}

void uncompress_eeprom_image(unsigned char *uncompressed_image,
			     unsigned char *eeprom_img_buf,
			     unsigned short eeprom_img_size)
{
	int i;
	unsigned char o = 0;
	unsigned char sym = 0;
	unsigned char syc = 0;

	int j = 0;

	for (i = 0; i < eeprom_img_size; ++i) {
		sym = eeprom_img_buf[i] & 0x80;
		syc = eeprom_img_buf[i] & 0x7F;

		while (syc) {
			if (sym)
				uncompressed_image[j] |= (0x1 << o);
			o++;
			syc--;
			if (o > 7) {
				o = 0;
				j++;
				uncompressed_image[j] = 0x0;
			}
		}
	}
}
```

## src/eeprom.h
```c
#ifndef __EEPROM_H__
#define __EEPROM_H__

#include <device.h>
#include <i2c.h>

#define I2C_EEPROM_ADDR 166 /* 0b10100110 */

int read_image_from_eeprom(struct device *i2c_dev,
			   unsigned char *eeprom_img_buf);

void uncompress_eeprom_image(unsigned char *uncompressed_image,
			     unsigned char *eeprom_img_buf,
			     unsigned short eeprom_img_size);
#endif
```

## src/epd.c
```c
/*
 * Copyright (c) 2013-2015 Pervasive Displays, Inc.
 * Copyright (c) 2017 Antmicro <www.antmicro.com>
 *
 *
 * SPDX-License-Identifier: Apache-2.0
 */

#include <zephyr.h>
#include <string.h>
#include <misc/printk.h>
#include <device.h>
#include <spi.h>
#include "gpio_fe310.h"
#include "spi-badge.h"
#include "epd.h"

#define PWM_GPIO 21
static void frame_fixed(struct EPD_configuration *epd, unsigned char fixed_value,
			 enum EPD_stage stage);

static void frame_data(struct EPD_configuration *epd, const unsigned char *image,
			const unsigned char *mask, enum EPD_stage stage);

static void frame_fixed_repeat(struct EPD_configuration *epd, unsigned char fixed_value,
			enum EPD_stage stage);

static void frame_data_repeat(struct EPD_configuration *epd, const unsigned char *image,
			const unsigned char *mask, enum EPD_stage stage);

static void one_line(struct EPD_configuration *epd, u16_t line, const unsigned char *data,
			unsigned char fixed_value, const unsigned char *mask,
			enum EPD_stage stage);

static struct EPD_private priv;

void epd_gpio_init(void)
{
	GPIO_REG(GPIO_OUTPUT_EN) |= ((0x1 << LCD_RESET_OFFSET));
	GPIO_REG(GPIO_OUTPUT_EN) |= (0x1 << LCD_DISCHARGE_OFFSET);
	GPIO_REG(GPIO_OUTPUT_EN) |= (0x1 << PWM_GPIO);
	GPIO_REG(GPIO_OUTPUT_EN) &= ~((0x1 << LCD_BUSY_OFFSET));
	GPIO_REG(GPIO_INPUT_EN) |= ((0x1 << LCD_BUSY_OFFSET));
	GPIO_REG(GPIO_INPUT_EN) &= ~((0x1 << LCD_RESET_OFFSET));
	GPIO_REG(GPIO_INPUT_EN) &= ~(0x1 << PWM_GPIO);

}


void epd_poweron(void)
{
	GPIO_REG(GPIO_OUTPUT_VAL) &= ~(0x1 << LCD_RESET_OFFSET);
	GPIO_REG(GPIO_OUTPUT_VAL) &= ~(0x1 << PWM_GPIO);
	k_sleep(5);

	unsigned char buf = 0x00; /* Dummy byte */

	spi_send_buffer(priv.spi_conf, &buf, 1);
	/* Drive panel_on pin here if present */

	k_sleep(10);

	GPIO_REG(GPIO_OUTPUT_VAL) |=  (0x1 << LCD_RESET_OFFSET);

	k_sleep(5);

	GPIO_REG(GPIO_OUTPUT_VAL) &= ~(0x1 << LCD_RESET_OFFSET);

	k_sleep(5);

	GPIO_REG(GPIO_OUTPUT_VAL) |=  (0x1 << LCD_RESET_OFFSET);
}

void epd_discharge(void)
{
	GPIO_REG(GPIO_OUTPUT_VAL) |=  (0x1 << LCD_DISCHARGE_OFFSET);
	k_sleep(150);
	GPIO_REG(GPIO_OUTPUT_VAL) &=  ~(0x1 << LCD_DISCHARGE_OFFSET);
}

void epd_poweroff(void)
{
	/* Undocumented but apparently required */
	epd_w1b(0x0b, 0x00);

	/* latch reset turn on */
	epd_w1b(0x03, 0x01);

	/* power off charge pump Vcom */
	epd_w1b(0x05, 0x03);

	/* power off charge pump neg voltage */
	epd_w1b(0x05, 0x01);

	k_sleep(120);

	/* discharge internal */
	epd_w1b(0x04, 0x80);

	/* turn off all charge pumps */
	epd_w1b(0x05, 0x00);

	/* turn of osc */
	epd_w1b(0x07, 0x01);

	k_sleep(50);

	GPIO_REG(GPIO_OUTPUT_VAL) &= ~(0x1 << LCD_RESET_OFFSET);
	/* Disable panel_on pin here if present */
	GPIO_REG(GPIO_OUTPUT_VAL) &= ~(0x1 << PWM_GPIO);

}

void epd_busy(void)
{
	volatile unsigned int input_val;

	while ((input_val = GPIO_REG(GPIO_INPUT_VAL))
		& (0x1 << LCD_BUSY_OFFSET)) {
	}
}

void epd_cmd(unsigned char cmd)
{
	/* disable RX fifo */
	unsigned char buf[2] = {LCD_COMMAND_INDEX_HEADER, cmd};

	spi_send_buffer(priv.spi_conf, buf, 2);
}

void epd_data(unsigned char *buff, u32_t len, unsigned char mode)
{
	size_t bufsize = len + 1;
	unsigned char buf[bufsize];
	size_t index = 0;

	buf[index++] = LCD_COMMAND_DATA_HEADER | mode;
	for (u32_t i = 0; i < len; i++) {
		/* If mode is SPI_READ, transfer dummy byte;
		 * if not transmit actual data
		 */
		buf[index++] = mode ? 0x00 : buff[i];
	}
	spi_send_buffer(priv.spi_conf, buf, bufsize);
}

unsigned char epd_getid(void)
{
	unsigned char rx_buf[2];
	/* Transmit header and dummy byte */
	unsigned char tx_buf[2] = {LCD_GET_ID_HEADER, 0x00};

	spi_transceive_buffer(priv.spi_conf, tx_buf, 2, rx_buf, 2);
	return rx_buf[1];
}

void epd_w1b(unsigned char cmd, unsigned char val)
{
	epd_cmd(cmd);
	epd_data(&val, 1, SPI_WRITE);
}

void epd_draw_line(unsigned char *data, unsigned char fixed_val)
{
	int b;
	unsigned char line_buffer[200];
	unsigned char *p = line_buffer;

	/* prepare data */
	/*  set border byte 0x00 */
	*(p++) = 0x00;
	/* fixed value */
	if (data == NULL) {
		/* set odd pixels (200 / 8 = 25 bytes) */
		for (b = 0; b < 25; b++)
			*(p++) = fixed_val;
		/* set 24 scan bytes (96 lines / 4 = 24 bytes) */
		for (b = 0; b < 24; b++)
			*(p++) = 0xFF;
		/* set even pixels (200 / 8 = 25 bytes) */
		for (b = 0; b < 25; b++)
			*(p++) = fixed_val;
	} else {
		printk("NYI\n");
		/* Here we have to interlace the data frame and convert */
		/* 200B of data to 50B of data */
	}
	epd_cmd(0x0A);
	epd_data(line_buffer, 75, SPI_WRITE);
	epd_w1b(0x02, 0x07);
}

void epd_init(struct spi_config *spi_conf)
{
	unsigned char data[128];
	unsigned char id;

	priv.spi_conf = spi_conf;

	epd_poweron();
	printk("Waiting for LCD...\n");
	epd_busy();
	id = epd_getid();
	id = epd_getid();

	if (id == 0x12)
		printk("ID OK: %x\n", id);
	else
		printk("Faulty ID: %x\n", id);

	epd_w1b(0x02, 0x40);

	epd_cmd(0x0F);
	epd_data(data, 1, SPI_READ);

	if ((data[0] & 0x80) != 0x80)
		printk("LCD may be broken. Breakage: %x\n", data[0]);

	epd_w1b(0x0B, 0x02);

	epd_cmd(0x01);
	data[0] = 0x00;
	data[1] = 0x00;
	data[2] = 0x00;
	data[3] = 0x00;
	data[4] = 0x01;
	data[5] = 0xFF;
	data[6] = 0xE0;
	data[7] = 0x00;

	epd_data(data, 8, SPI_WRITE);

	epd_w1b(0x07, 0xD1);
	epd_w1b(0x08, 0x02);
	epd_w1b(0x09, 0xC2);
	epd_w1b(0x04, 0x03);
	epd_w1b(0x03, 0x01);
	epd_w1b(0x03, 0x00);
	k_sleep(10);

	/* enable charge pumps */
	int j;

	for (j = 0; j < 4; j++) {
		epd_w1b(0x05, 0x01);
		k_sleep(10);
		epd_w1b(0x05, 0x03);
		k_sleep(10);
		epd_w1b(0x05, 0x0F);
		k_sleep(10);

		epd_cmd(0x0F);
		epd_data(data, 1, SPI_READ);
		/* we should get 0x04 here, unfortunately I receise 0x00 */
		printk("Voltage status: %x\n", data[0]);
		if ((data[0] & 0x40) == 0x40)
			break;
	}

	epd_w1b(0x02, 0x04);
	printk("LCD initialized.\n");
}


static void frame_fixed(struct EPD_configuration *epd, unsigned char fixed_value,
			 enum EPD_stage stage)
{
	for (unsigned char l = 0; l < epd->lines_per_display ; ++l) {
		one_line(epd, l, NULL, fixed_value, NULL, stage);
	}
}


static void frame_data(struct EPD_configuration *epd, const unsigned char *image,
			const unsigned char *mask, enum EPD_stage stage)
{
	if (mask == NULL) {
		for (unsigned char l = 0; l < epd->lines_per_display ; ++l) {
			one_line(epd, l, &image[l * epd->bytes_per_line],
				 0, NULL, stage);
		}
	} else {
		for (unsigned char l = 0; l < epd->lines_per_display ; ++l) {
			size_t n = l * epd->bytes_per_line;

			one_line(epd, l, &image[n], 0, &mask[n], stage);
		}
	}
}

static void frame_fixed_repeat(struct EPD_configuration *epd, unsigned char fixed_value,
			enum EPD_stage stage)
{
	/* We should base it on stage time,
	 * for now just do a fixed number of repetitions
	 */
	for (int i = 0; i < epd->stage_repetitions; ++i) {
		frame_fixed(epd, fixed_value, stage);
	}
}


static void frame_data_repeat(struct EPD_configuration *epd, const unsigned char *image,
			const unsigned char *mask, enum EPD_stage stage)
{
	/* We should base it on stage time,
	 * for now just do a fixed number of repetitions
	 */
	for (int i = 0; i < epd->stage_repetitions; ++i) {
		frame_data(epd, image, mask, stage);
	}
}

/* pixels on display are numbered from 1 so even is actually bits 1,3,5,... */
static void even_pixels(struct EPD_configuration *epd, unsigned char **pp, const unsigned char *data,
			unsigned char fixed_value, const unsigned char *mask,
			enum EPD_stage stage)
{

	for (u16_t b = 0; b < epd->bytes_per_line; ++b) {
		if (data != NULL) {
			unsigned char pixels = data[b] & 0xaa;
			unsigned char pixel_mask = 0xff;

			if (mask != NULL) {
				pixel_mask = (mask[b] ^ pixels) & 0xaa;
				pixel_mask |= pixel_mask >> 1;
			}
			switch (stage) {
			/* B -> W, W -> B (Current Image) */
			case EPD_compensate:
				pixels = 0xaa | ((pixels ^ 0xaa) >> 1);
				break;
			/* B -> N, W -> W (Current Image) */
			case EPD_white:
				pixels = 0x55 + ((pixels ^ 0xaa) >> 1);
				break;
			/* B -> N, W -> B (New Image) */
			case EPD_inverse:
				pixels = 0x55 | (pixels ^ 0xaa);
				break;
			/* B -> B, W -> W (New Image) */
			case EPD_normal:
				pixels = 0xaa | (pixels >> 1);
				break;
			}
			pixels = (pixels & pixel_mask) | (~pixel_mask & 0x55);
			unsigned char p1 = (pixels >> 6) & 0x03;
			unsigned char p2 = (pixels >> 4) & 0x03;
			unsigned char p3 = (pixels >> 2) & 0x03;
			unsigned char p4 = (pixels >> 0) & 0x03;

			pixels = (p1 << 0) | (p2 << 2) | (p3 << 4) | (p4 << 6);
			*(*pp)++ = pixels;
		} else {
			*(*pp)++ = fixed_value;
		}
	}
}

/* pixels on display are numbered from 1 so odd is actually bits 0,2,4,... */
static void odd_pixels(struct EPD_configuration *epd, unsigned char **pp, const unsigned char *data,
			unsigned char fixed_value, const unsigned char *mask,
			enum EPD_stage stage)
{
	for (u16_t b = epd->bytes_per_line; b > 0; --b) {
		if (data != NULL) {
			unsigned char pixels = data[b - 1] & 0x55;
			unsigned char pixel_mask = 0xff;

			if (mask != NULL) {
				pixel_mask = (mask[b - 1] ^ pixels) & 0x55;
				pixel_mask |= pixel_mask << 1;
			}
			switch (stage) {
			/* B -> W, W -> B (Current Image) */
			case EPD_compensate:
				pixels = 0xaa | (pixels ^ 0x55);
				break;
			/* B -> N, W -> W (Current Image) */
			case EPD_white:
				pixels = 0x55 + (pixels ^ 0x55);
				break;
			/* B -> N, W -> B (New Image) */
			case EPD_inverse:
				pixels = 0x55 | ((pixels ^ 0x55) << 1);
				break;
			/* B -> B, W -> W (New Image) */
			case EPD_normal:
				pixels = 0xaa | pixels;
				break;
			}
			pixels = (pixels & pixel_mask) | (~pixel_mask & 0x55);
			*(*pp)++ = pixels;
		} else {
			*(*pp)++ = fixed_value;
		}
	}
}

/* interleave bits: (byte)76543210 -> (16 bit).7.6.5.4.3.2.1 */
static inline u16_t interleave_bits(u16_t value)
{
	value = (value | (value << 4)) & 0x0f0f;
	value = (value | (value << 2)) & 0x3333;
	value = (value | (value << 1)) & 0x5555;
	return value;
}

/* pixels on display are numbered from 1 */
static void all_pixels(struct EPD_configuration *epd, unsigned char **pp, const unsigned char *data,
			unsigned char fixed_value, const unsigned char *mask,
			enum EPD_stage stage)
{
	for (u16_t b = epd->bytes_per_line; b > 0; --b) {
		if (data != NULL) {
			u16_t pixels = interleave_bits(data[b - 1]);
			u16_t pixel_mask = 0xffff;

			if (mask != NULL) {
				u16_t pixel_mask = interleave_bits(mask[b - 1]);

				pixel_mask = (pixel_mask ^ pixels) & 0x5555;
				pixel_mask |= pixel_mask << 1;
			}
			switch (stage) {
			/* B -> W, W -> B (Current Image) */
			case EPD_compensate:
				pixels = 0xaaaa | (pixels ^ 0x5555);
				break;
			/* B -> N, W -> W (Current Image) */
			case EPD_white:
				pixels = 0x5555 + (pixels ^ 0x5555);
				break;
			/* B -> N, W -> B (New Image) */
			case EPD_inverse:
				pixels = 0x5555 | ((pixels ^ 0x5555) << 1);
				break;
			/* B -> B, W -> W (New Image) */
			case EPD_normal:
				pixels = 0xaaaa | pixels;
				break;
			}
			pixels = (pixels & pixel_mask) | (~pixel_mask & 0x5555);
			*(*pp)++ = pixels >> 8;
			*(*pp)++ = pixels;
		} else {
			*(*pp)++ = fixed_value;
			*(*pp)++ = fixed_value;
		}
	}
}

/* output one line of scan and data bytes to the display */
static void one_line(struct EPD_configuration *epd, u16_t line, const unsigned char *data,
			unsigned char fixed_value, const unsigned char *mask,
			enum EPD_stage stage)
{
	/* send data */
	epd_cmd(0x0a);

	/* CS low */
	unsigned char *p = epd->line_buffer;

	if (epd->pre_border_byte) {
		*p++ = 0x00;
	}

	if (epd->middle_scan) {
		/* data bytes */
		odd_pixels(epd, &p, data, fixed_value, mask, stage);

		/* scan line */
		for (u16_t b = epd->bytes_per_scan; b > 0; --b) {
			if (line / 4 == b - 1) {
				*p++ = 0x03 << (2 * (line & 0x03));
			} else {
				*p++ = 0x00;
			}
		}

		/* data bytes */
		even_pixels(epd, &p, data, fixed_value, mask, stage);

	} else {
		/* even scan line, but as lines on display are numbered
		 * from 1, line: 1,3,5,...
		 */
		for (u16_t b = 0; b < epd->bytes_per_scan; ++b) {
			if (0 != (line & 0x01) && line / 8 == b) {
				*p++ = 0xc0 >> (line & 0x06);
			} else {
				*p++ = 0x00;
			}
		}

		/* data bytes */
		all_pixels(epd, &p, data, fixed_value, mask, stage);

		/* odd scan line, but as lines on display are numbered
		 * from 1, line: 0,2,4,6,...
		 */
		for (u16_t b = epd->bytes_per_scan; b > 0; --b) {
			if (0 == (line & 0x01) && line / 8 == b - 1) {
				*p++ = 0x03 << (line & 0x06);
			} else {
				*p++ = 0x00;
			}
		}
	}

	/* post data border byte */
	switch (epd->border_byte) {
	/* no border byte requred */
	case EPD_BORDER_BYTE_NONE:
		break;
	/* border byte == 0x00 requred */
	case EPD_BORDER_BYTE_ZERO:
		*p++ = 0x00;
		break;
	/* border byte needs to be set */
	case EPD_BORDER_BYTE_SET:
		switch (stage) {
		case EPD_compensate:
		case EPD_white:
		case EPD_inverse:
			*p++ = 0x00;
			break;
		case EPD_normal:
			*p++ = 0xaa;
			break;
		}
		break;
	}
	/* send the accumulated line buffer */
	epd_data(epd->line_buffer, p - epd->line_buffer, SPI_WRITE);

	/* output data to panel */
	epd_w1b(0x02, 0x07);

	/* Delay_ms(1); */
}

/* clear display (anything -> white) */
void epd_clear(struct EPD_configuration *epd)
{
	printk("Clearing screen\n");
	frame_fixed_repeat(epd, 0xff, EPD_compensate);
	frame_fixed_repeat(epd, 0xff, EPD_white);
	frame_fixed_repeat(epd, 0xaa, EPD_inverse);
	frame_fixed_repeat(epd, 0xaa, EPD_normal);
}

/* assuming a clear (white) screen output an image */
void epd_image_0(struct EPD_configuration *epd, const unsigned char *image)
{
	frame_fixed_repeat(epd, 0xaa, EPD_compensate);
	frame_fixed_repeat(epd, 0xaa, EPD_white);
	frame_data_repeat(epd, image, NULL, EPD_inverse);
	frame_data_repeat(epd, image, NULL, EPD_normal);
}

/* change from old image to new image */
void epd_image(struct EPD_configuration *epd, const unsigned char *old_image,
		const unsigned char *new_image)
{
	frame_data_repeat(epd, old_image, NULL, EPD_compensate);
	frame_data_repeat(epd, old_image, NULL, EPD_white);
	frame_data_repeat(epd, new_image, NULL, EPD_inverse);
	frame_data_repeat(epd, new_image, NULL, EPD_normal);
}

/* change from old image to new image */
void epd_partial_image(struct EPD_configuration *epd, const unsigned char *old_image,
		const unsigned char *new_image)
{
	/* Only need last stage for partial update */
	/* See discussion on issue #19 in the repaper/gratis
	 * repository on github
	 */
	frame_data_repeat(epd, new_image, old_image, EPD_normal);
}
```

## src/epd.h
```c
#ifndef __EPD_H__
#define __EPD_H__

#define LCD_COMMAND_INDEX_HEADER 0x70
#define LCD_COMMAND_DATA_HEADER 0x72
#define LCD_GET_ID_HEADER 0x71

void epd_data(unsigned char *buff, u32_t len, unsigned char mode);
void epd_cmd(unsigned char cmd);
void epd_w1b(unsigned char cmd, unsigned char val);
void epd_poweron(void);

enum EPD_size {
	EPD_1_44,        /* 128 x 96 */
	EPD_1_9,         /* 144 x 128 */
	EPD_2_0,         /* 200 x 96 */
	EPD_2_6,         /* 232 x 128 */
	EPD_2_7          /* 264 x 176 */
};

enum EPD_error {        /* error codes */
	EPD_OK,
	EPD_UNSUPPORTED_COG,
	EPD_PANEL_BROKEN,
	EPD_DC_FAILED,
	EPD_UNDEFINED
};

/* types */
enum EPD_stage {           /* Image pixel -> Display pixel */
	EPD_compensate,  /* B -> W, W -> B (Current Image) */
	EPD_white,       /* B -> N, W -> W (Current Image) */
	EPD_inverse,     /* B -> N, W -> B (New Image) */
	EPD_normal       /* B -> B, W -> W (New Image) */
};

enum EPD_border_byte {
	EPD_BORDER_BYTE_NONE,  /* no border byte requred */
	EPD_BORDER_BYTE_ZERO,  /* border byte == 0x00 requred */
	EPD_BORDER_BYTE_SET,   /* border byte needs to be set */
};

/* panel configuration */
struct EPD_configuration {
	enum EPD_size size;
	int stage_repetitions;
	int lines_per_display;
	int dots_per_line;
	int bytes_per_line;
	int bytes_per_scan;
	bool middle_scan;

	bool pre_border_byte;
	enum EPD_border_byte border_byte;

	unsigned char *line_buffer;
	size_t line_buffer_size;
};

struct EPD_private {
	struct spi_config *spi_conf;
};

void epd_init(struct spi_config *spi_conf);
void epd_gpio_init(void);
void epd_clear(struct EPD_configuration *epd);
void epd_image_0(struct EPD_configuration *epd, const unsigned char *image);
void epd_image(struct EPD_configuration *epd, const unsigned char *old_image,
		const unsigned char *new_image);
void epd_poweroff(void);
void epd_discharge(void);

#endif
```

## src/gpio_fe310.h
```c
#ifndef _SIFIVE_SPI_H
#define _SIFIVE_SPI_H

/* Register offsets */

#define SPI_REG_SCKDIV          0x00
#define SPI_REG_SCKMODE         0x04
#define SPI_REG_CSID            0x10
#define SPI_REG_CSDEF           0x14
#define SPI_REG_CSMODE          0x18

#define SPI_REG_DCSSCK          0x28
#define SPI_REG_DSCKCS          0x2a
#define SPI_REG_DINTERCS        0x2c
#define SPI_REG_DINTERXFR       0x2e

#define SPI_REG_FMT             0x40
#define SPI_REG_TXFIFO          0x48
#define SPI_REG_RXFIFO          0x4c
#define SPI_REG_TXCTRL          0x50
#define SPI_REG_RXCTRL          0x54

#define SPI_REG_FCTRL           0x60
#define SPI_REG_FFMT            0x64

#define SPI_REG_IE              0x70
#define SPI_REG_IP              0x74

/* Fields */

#define SPI_SCK_POL             0x1
#define SPI_SCK_PHA             0x2

#define SPI_FMT_PROTO(x)        ((x) & 0x3)
#define SPI_FMT_ENDIAN(x)       (((x) & 0x1) << 2)
#define SPI_FMT_DIR(x)          (((x) & 0x1) << 3)
#define SPI_FMT_LEN(x)          (((x) & 0xf) << 16)

/* TXCTRL register */
#define SPI_TXWM(x)             ((x) & 0xffff)
/* RXCTRL register */
#define SPI_RXWM(x)             ((x) & 0xffff)

#define SPI_IP_TXWM             0x1
#define SPI_IP_RXWM             0x2

#define SPI_FCTRL_EN            0x1

#define SPI_INSN_CMD_EN         0x1
#define SPI_INSN_ADDR_LEN(x)    (((x) & 0x7) << 1)
#define SPI_INSN_PAD_CNT(x)     (((x) & 0xf) << 4)
#define SPI_INSN_CMD_PROTO(x)   (((x) & 0x3) << 8)
#define SPI_INSN_ADDR_PROTO(x)  (((x) & 0x3) << 10)
#define SPI_INSN_DATA_PROTO(x)  (((x) & 0x3) << 12)
#define SPI_INSN_CMD_CODE(x)    (((x) & 0xff) << 16)
#define SPI_INSN_PAD_CODE(x)    (((x) & 0xff) << 24)

#define SPI_TXFIFO_FULL  (1 << 31)
#define SPI_RXFIFO_EMPTY (1 << 31)

/* Values */

#define SPI_CSMODE_AUTO         0
#define SPI_CSMODE_HOLD         2
#define SPI_CSMODE_OFF          3

#define SPI_DIR_RX              0
#define SPI_DIR_TX              1

#define SPI_PROTO_S             0
#define SPI_PROTO_D             1
#define SPI_PROTO_Q             2

#define SPI_ENDIAN_MSB          0
#define SPI_ENDIAN_LSB          1

/* IOF masks */
#define SPI1_CTRL_ADDR          0x10024000
#define IOF0_SPI1_MASK          0x000007FC
#define GPIO_CTRL_ADDR          0x10012000
#define SPI11_NUM_SS     (4)
#define IOF_SPI1_SS0          (2u)
#define IOF_SPI1_SS1          (8u)
#define IOF_SPI1_SS2          (9u)
#define IOF_SPI1_SS3          (10u)
#define IOF_SPI1_MOSI         (3u)
#define IOF_SPI1_MISO         (4u)
#define IOF_SPI1_SCK          (5u)
#define IOF_SPI1_DQ0          (3u)
#define IOF_SPI1_DQ1          (4u)
#define IOF_SPI1_DQ2          (6u)
#define IOF_SPI1_DQ3          (7u)

/* gpio defines */
#define GPIO_INPUT_VAL  (0x00)
#define GPIO_INPUT_EN   (0x04)
#define GPIO_OUTPUT_EN  (0x08)
#define GPIO_OUTPUT_VAL (0x0C)
#define GPIO_PULLUP_EN  (0x10)
#define GPIO_DRIVE      (0x14)
#define GPIO_RISE_IE    (0x18)
#define GPIO_RISE_IP    (0x1C)
#define GPIO_FALL_IE    (0x20)
#define GPIO_FALL_IP    (0x24)
#define GPIO_HIGH_IE    (0x28)
#define GPIO_HIGH_IP    (0x2C)
#define GPIO_LOW_IE     (0x30)
#define GPIO_LOW_IP     (0x34)
#define GPIO_IOF_EN     (0x38)
#define GPIO_IOF_SEL    (0x3C)
#define GPIO_OUTPUT_XOR    (0x40)


#define INT_SPI1_BASE 6
#define _REG32(p, i) (*(volatile uint32_t *) ((p) + (i)))
#define _REG32P(p, i) ((volatile uint32_t *) ((p) + (i)))

#define SPI1_REG(offset) _REG32(SPI1_CTRL_ADDR, offset)
#define GPIO_REG(offset) _REG32(GPIO_CTRL_ADDR, offset)
#endif /* _SIFIVE_SPI_H */
```

## src/risc-v-logo.h
```c
#ifndef __RISC_V_LOGO_H__
#define __RISC_V_LOGO_H__

unsigned char riscv_logo_bits[] = {
   0x00, 0x00, 0x00, 0x00, 0x00, 0x00, 0x00, 0x00, 0x00, 0x00, 0x00, 0x00,
   0x00, 0x00, 0x00, 0x00, 0x00, 0x00, 0x00, 0x00, 0x00, 0x00, 0x00, 0x00,
   0x00, 0x00, 0x00, 0x00, 0x00, 0x00, 0x00, 0x00, 0x00, 0x00, 0x00, 0x00,
   0x00, 0x00, 0x00, 0x00, 0x00, 0x00, 0x00, 0x00, 0x00, 0x00, 0x00, 0x00,
   0x00, 0x00, 0x00, 0x00, 0x00, 0x00, 0x00, 0x00, 0x00, 0x00, 0x00, 0x00,
   0x00, 0x00, 0x00, 0x00, 0x00, 0x00, 0x00, 0x00, 0x00, 0x00, 0x00, 0x00,
   0x00, 0x00, 0x00, 0x00, 0x00, 0x00, 0x00, 0x00, 0x00, 0x00, 0x00, 0x00,
   0x00, 0x00, 0x00, 0x00, 0x00, 0x00, 0x00, 0x00, 0x00, 0x00, 0x00, 0x00,
   0x00, 0x00, 0x00, 0x00, 0x00, 0x00, 0x00, 0x00, 0x00, 0x00, 0x00, 0x00,
   0x00, 0x00, 0x00, 0x00, 0x00, 0x00, 0x00, 0x00, 0x00, 0x00, 0x00, 0x00,
   0x00, 0x00, 0x00, 0x00, 0x00, 0x00, 0x00, 0x00, 0x00, 0x00, 0x00, 0x00,
   0x00, 0x00, 0x00, 0x00, 0x00, 0x00, 0x00, 0x00, 0x00, 0x00, 0x00, 0x00,
   0x00, 0x00, 0x00, 0x00, 0x00, 0x00, 0x00, 0x00, 0x00, 0x00, 0x00, 0x00,
   0x00, 0x00, 0x00, 0x00, 0x00, 0x00, 0x00, 0x00, 0x00, 0x00, 0x00, 0x00,
   0x00, 0x00, 0x00, 0x00, 0x00, 0x00, 0x00, 0x00, 0x00, 0x00, 0x00, 0x00,
   0x00, 0x00, 0x00, 0x00, 0x00, 0x00, 0x00, 0x00, 0x00, 0x00, 0x00, 0x00,
   0x00, 0x00, 0x00, 0x00, 0x00, 0x00, 0x00, 0x00, 0x00, 0x00, 0x00, 0x00,
   0x00, 0x00, 0x00, 0x00, 0x00, 0x00, 0x00, 0x00, 0x00, 0x00, 0x00, 0x00,
   0x00, 0x00, 0x00, 0x00, 0x00, 0x00, 0x00, 0x00, 0x00, 0x00, 0x00, 0x00,
   0x00, 0x00, 0x00, 0x00, 0x00, 0x00, 0x00, 0x00, 0x00, 0x00, 0x00, 0x00,
   0x00, 0x00, 0x00, 0x00, 0x00, 0x00, 0x00, 0x00, 0x00, 0x00, 0x00, 0x00,
   0x00, 0x00, 0x00, 0x00, 0x00, 0x00, 0x00, 0x00, 0x00, 0x00, 0x00, 0x00,
   0x00, 0x00, 0x00, 0x00, 0x00, 0x00, 0x00, 0x00, 0x00, 0x00, 0x00, 0x00,
   0x00, 0x00, 0x00, 0x00, 0x00, 0x00, 0x00, 0x00, 0x00, 0x00, 0x00, 0x00,
   0x00, 0x00, 0x00, 0x00, 0x00, 0x00, 0x00, 0x00, 0x00, 0x00, 0x00, 0x00,
   0x00, 0x00, 0x00, 0x00, 0x00, 0x00, 0x00, 0x00, 0x00, 0x00, 0x00, 0x00,
   0x00, 0x00, 0x00, 0x00, 0x00, 0x00, 0x00, 0x00, 0x00, 0x00, 0x00, 0x00,
   0x00, 0x00, 0x00, 0x00, 0x00, 0x00, 0x00, 0x00, 0x00, 0x00, 0x00, 0x00,
   0x00, 0x00, 0x00, 0x00, 0x00, 0x00, 0x00, 0x00, 0x00, 0x00, 0x00, 0x00,
   0x00, 0x00, 0x00, 0x00, 0x00, 0x00, 0x00, 0x00, 0x00, 0x00, 0x00, 0x00,
   0x00, 0x00, 0x00, 0x00, 0x00, 0x00, 0x00, 0x00, 0x00, 0x00, 0x00, 0x00,
   0x00, 0x00, 0x00, 0x00, 0x00, 0x00, 0x00, 0x00, 0x00, 0x00, 0x00, 0x00,
   0x00, 0x00, 0x00, 0x00, 0x00, 0x00, 0x00, 0x00, 0x00, 0x00, 0x00, 0x00,
   0x00, 0x00, 0x00, 0x00, 0x00, 0x00, 0x00, 0x00, 0x00, 0x00, 0x00, 0x00,
   0x00, 0x00, 0x00, 0x00, 0x00, 0x00, 0x00, 0x00, 0x00, 0x00, 0x00, 0x00,
   0x00, 0x00, 0x00, 0x00, 0x00, 0x00, 0x00, 0x00, 0x00, 0x00, 0x00, 0x00,
   0x00, 0x00, 0x00, 0x00, 0x00, 0x00, 0x00, 0x00, 0x00, 0x00, 0x00, 0x00,
   0x00, 0x00, 0x00, 0x00, 0x00, 0x00, 0x00, 0x00, 0x00, 0x00, 0x00, 0x00,
   0x00, 0x00, 0x00, 0x00, 0x00, 0x00, 0x00, 0x00, 0x00, 0x00, 0x00, 0x00,
   0x00, 0x00, 0x00, 0x00, 0x00, 0x00, 0x00, 0x00, 0x00, 0x00, 0x00, 0x00,
   0x00, 0x00, 0x00, 0x00, 0x00, 0x00, 0x00, 0x00, 0x00, 0x00, 0x00, 0x00,
   0x00, 0x00, 0x00, 0x00, 0x00, 0x00, 0x00, 0x00, 0x00, 0x00, 0x00, 0x00,
   0x00, 0x00, 0x00, 0x00, 0x00, 0x00, 0x00, 0x00, 0x00, 0x00, 0x00, 0x00,
   0x00, 0x00, 0x00, 0x00, 0x00, 0x00, 0x00, 0x00, 0x00, 0x00, 0x00, 0x00,
   0x00, 0x00, 0x00, 0x00, 0x00, 0x00, 0x00, 0x00, 0x00, 0x00, 0x00, 0x00,
   0x00, 0x00, 0x00, 0x00, 0x00, 0x00, 0x00, 0x00, 0x00, 0x00, 0x00, 0x00,
   0x00, 0x00, 0x00, 0x00, 0x00, 0x00, 0x00, 0x00, 0x00, 0x00, 0x00, 0x00,
   0x00, 0x00, 0x00, 0x00, 0x00, 0x00, 0x00, 0x00, 0x00, 0x00, 0x00, 0x00,
   0x00, 0x00, 0x00, 0x00, 0x00, 0x00, 0x00, 0x00, 0x00, 0x00, 0x00, 0x00,
   0x00, 0x00, 0x00, 0x00, 0x00, 0x00, 0x00, 0x00, 0x00, 0x00, 0x00, 0x00,
   0x00, 0x00, 0x00, 0x00, 0x00, 0x00, 0x00, 0x00, 0x00, 0x00, 0x00, 0x00,
   0x00, 0x00, 0x00, 0x00, 0x00, 0x00, 0x00, 0x00, 0x00, 0x00, 0x00, 0x00,
   0x00, 0x00, 0x00, 0x00, 0x00, 0x00, 0x00, 0x00, 0x00, 0x00, 0x00, 0x00,
   0x00, 0x00, 0x00, 0x00, 0x00, 0x00, 0x00, 0x00, 0x00, 0x00, 0x00, 0x00,
   0x00, 0x00, 0x00, 0x00, 0x00, 0x00, 0x00, 0x00, 0x00, 0x00, 0x00, 0x00,
   0x00, 0x00, 0x00, 0x00, 0x00, 0x00, 0x00, 0x00, 0x00, 0x00, 0x00, 0x00,
   0x00, 0x00, 0x00, 0x00, 0x00, 0x00, 0x00, 0x00, 0x00, 0x00, 0x00, 0x00,
   0x00, 0x00, 0x00, 0x00, 0x00, 0x00, 0x00, 0x00, 0x00, 0x00, 0x00, 0x00,
   0x00, 0x00, 0x00, 0x00, 0x00, 0x00, 0x00, 0x00, 0x00, 0x00, 0x00, 0x00,
   0x00, 0x00, 0x00, 0x00, 0x00, 0x00, 0x00, 0x00, 0x00, 0x00, 0x00, 0x00,
   0x00, 0x00, 0x00, 0x00, 0x00, 0x00, 0x00, 0x00, 0x00, 0x00, 0x00, 0x00,
   0x00, 0x00, 0x00, 0x00, 0x00, 0x00, 0x00, 0x00, 0x00, 0x00, 0x00, 0x00,
   0x00, 0x00, 0x00, 0x00, 0x00, 0x00, 0x00, 0x00, 0x00, 0x00, 0x00, 0x00,
   0x00, 0x00, 0x00, 0x00, 0x00, 0x00, 0x00, 0x00, 0x00, 0x00, 0x00, 0x00,
   0x00, 0x00, 0x00, 0x00, 0x00, 0x00, 0x00, 0x00, 0x00, 0x00, 0x00, 0x00,
   0x00, 0x00, 0x00, 0x00, 0x00, 0x00, 0x00, 0x00, 0x00, 0x00, 0x00, 0x00,
   0x00, 0x00, 0x00, 0x00, 0x00, 0x00, 0x00, 0x00, 0x00, 0x00, 0xff, 0xff,
   0x1f, 0x00, 0x00, 0x00, 0x00, 0x00, 0x00, 0x00, 0x00, 0x00, 0x00, 0x00,
   0x00, 0x00, 0x00, 0x00, 0x00, 0x00, 0x00, 0x00, 0x00, 0x00, 0x00, 0xfc,
   0xff, 0x1f, 0x00, 0x00, 0x00, 0x00, 0x00, 0x00, 0x00, 0x00, 0x00, 0x00,
   0x00, 0x00, 0x00, 0x00, 0x00, 0x00, 0x00, 0x00, 0x00, 0x00, 0x00, 0x00,
   0xf8, 0xff, 0x1f, 0x00, 0x00, 0x00, 0x00, 0x00, 0x00, 0x00, 0x00, 0x00,
   0x00, 0x00, 0x00, 0x00, 0x00, 0x00, 0x00, 0x00, 0x00, 0x00, 0x00, 0x00,
   0x00, 0xf0, 0xff, 0x1f, 0x00, 0x00, 0x00, 0x00, 0x00, 0x00, 0x00, 0x00,
   0x00, 0x00, 0x00, 0x00, 0x00, 0x00, 0x00, 0x00, 0x00, 0x00, 0x00, 0x00,
   0xe0, 0x3f, 0xe0, 0xff, 0x1f, 0x00, 0x00, 0x00, 0x00, 0x00, 0x00, 0x00,
   0x00, 0x00, 0x00, 0x00, 0x00, 0x00, 0x00, 0x00, 0x00, 0x00, 0x00, 0x00,
   0x00, 0xe0, 0xff, 0xe0, 0xff, 0x1f, 0x00, 0xfe, 0xff, 0xff, 0x07, 0x78,
   0x80, 0xff, 0xff, 0xff, 0x03, 0xf0, 0xff, 0xff, 0x03, 0xe0, 0x03, 0x00,
   0xc0, 0x07, 0xe0, 0xff, 0xc1, 0xff, 0x1f, 0x00, 0xfe, 0xff, 0xff, 0x1f,
   0xf8, 0xc0, 0xff, 0xff, 0xff, 0x03, 0xfc, 0xff, 0xff, 0x07, 0xe0, 0x07,
   0x00, 0xe0, 0x07, 0xe0, 0xff, 0xc3, 0xff, 0x1f, 0x00, 0xfe, 0xff, 0xff,
   0x3f, 0xf8, 0xe0, 0xff, 0xff, 0xff, 0x03, 0xff, 0xff, 0xff, 0x07, 0xc0,
   0x0f, 0x00, 0xf0, 0x03, 0xe0, 0xff, 0xc3, 0xff, 0x1f, 0x00, 0xfe, 0xff,
   0xff, 0x7f, 0xf8, 0xf0, 0xff, 0xff, 0xff, 0x83, 0xff, 0xff, 0xff, 0x07,
   0xc0, 0x0f, 0x00, 0xf0, 0x03, 0xe0, 0xff, 0xc3, 0xff, 0x0f, 0x00, 0xfe,
   0xff, 0xff, 0x7f, 0xf8, 0xf8, 0xff, 0xff, 0xff, 0xc3, 0xff, 0xff, 0xff,
   0x07, 0x80, 0x1f, 0x00, 0xf8, 0x01, 0xe0, 0xff, 0xc3, 0xff, 0x07, 0x00,
   0x3e, 0x00, 0x00, 0xfc, 0xf8, 0xf8, 0x01, 0x00, 0x00, 0xe0, 0x1f, 0x00,
   0x00, 0x00, 0x80, 0x1f, 0x00, 0xfc, 0x01, 0xe0, 0xff, 0xc3, 0xff, 0x07,
   0x00, 0x3e, 0x00, 0x00, 0xf8, 0xf8, 0xf8, 0x00, 0x00, 0x00, 0xe0, 0x07,
   0x00, 0x00, 0x00, 0x00, 0x3f, 0x00, 0xfc, 0x00, 0xe0, 0xff, 0xc3, 0xff,
   0x03, 0x00, 0x3e, 0x00, 0x00, 0xf8, 0xf8, 0xf8, 0x00, 0x00, 0x00, 0xf0,
   0x03, 0x00, 0x00, 0x00, 0x00, 0x3f, 0x00, 0x7e, 0x00, 0xe0, 0xff, 0xc1,
   0xff, 0x01, 0x00, 0x3e, 0x00, 0x00, 0xfc, 0xf8, 0xf8, 0x01, 0x00, 0x00,
   0xf0, 0x01, 0x00, 0x00, 0x00, 0x00, 0x7e, 0x00, 0x7e, 0x00, 0xe0, 0xff,
   0xe0, 0xff, 0x01, 0x00, 0xfe, 0xff, 0xff, 0x7f, 0xf8, 0xf8, 0xff, 0xff,
   0x3f, 0xf0, 0x01, 0x00, 0x00, 0xe0, 0x3f, 0xfc, 0x00, 0x3f, 0x00, 0xe0,
   0x3f, 0xe0, 0xff, 0x00, 0x00, 0xfe, 0xff, 0xff, 0x7f, 0xf8, 0xf0, 0xff,
   0xff, 0x7f, 0xf0, 0x01, 0x00, 0x00, 0xe0, 0x7f, 0xfc, 0x00, 0x3f, 0x00,
   0x60, 0x00, 0xf0, 0x7f, 0x00, 0x00, 0xfe, 0xff, 0xff, 0x3f, 0xf8, 0xe0,
   0xff, 0xff, 0xff, 0xf0, 0x01, 0x00, 0x00, 0xe0, 0x7f, 0xf8, 0x81, 0x1f,
   0x00, 0x60, 0x00, 0xf8, 0x3f, 0x10, 0x00, 0xfe, 0xff, 0xff, 0x1f, 0xf8,
   0xc0, 0xff, 0xff, 0xff, 0xf1, 0x01, 0x00, 0x00, 0xe0, 0x7f, 0xf8, 0xc1,
   0x1f, 0x00, 0xe0, 0x00, 0xfc, 0x3f, 0x18, 0x00, 0xfe, 0xff, 0xff, 0x07,
   0xf8, 0x00, 0xff, 0xff, 0xff, 0xf3, 0x01, 0x00, 0x00, 0xe0, 0x3f, 0xf0,
   0xc3, 0x0f, 0x00, 0xe0, 0x01, 0xff, 0x1f, 0x1c, 0x00, 0x3e, 0x00, 0xf0,
   0x03, 0xf8, 0x00, 0x00, 0x00, 0xf0, 0xf3, 0x03, 0x00, 0x00, 0x00, 0x00,
   0xf0, 0xe3, 0x07, 0x00, 0xe0, 0x81, 0xff, 0x0f, 0x1e, 0x00, 0x3e, 0x00,
   0xe0, 0x07, 0xf8, 0x00, 0x00, 0x00, 0xe0, 0xf3, 0x03, 0x00, 0x00, 0x00,
   0x00, 0xe0, 0xe7, 0x07, 0x00, 0xe0, 0x03, 0xff, 0x0f, 0x1e, 0x00, 0x3e,
   0x00, 0xc0, 0x0f, 0xf8, 0x00, 0x00, 0x00, 0xf0, 0xe3, 0x07, 0x00, 0x00,
   0x00, 0x00, 0xc0, 0xff, 0x03, 0x00, 0xe0, 0x07, 0xff, 0x07, 0x1f, 0x00,
   0x3e, 0x00, 0xc0, 0x1f, 0xf8, 0xf8, 0xff, 0xff, 0xff, 0xe3, 0xff, 0xff,
   0xff, 0x03, 0x00, 0xc0, 0xff, 0x03, 0x00, 0xe0, 0x0f, 0xfe, 0x83, 0x1f,
   0x00, 0x3e, 0x00, 0x80, 0x1f, 0xf8, 0xf8, 0xff, 0xff, 0xff, 0xc1, 0xff,
   0xff, 0xff, 0x07, 0x00, 0x80, 0xff, 0x01, 0x00, 0xe0, 0x1f, 0xfc, 0x83,
   0x1f, 0x00, 0x3e, 0x00, 0x00, 0x3f, 0xf8, 0xf8, 0xff, 0xff, 0xff, 0x81,
   0xff, 0xff, 0xff, 0x07, 0x00, 0x80, 0xff, 0x00, 0x00, 0xe0, 0x1f, 0xf8,
   0xc1, 0x1f, 0x00, 0x3e, 0x00, 0x00, 0x7f, 0xf8, 0xf8, 0xff, 0xff, 0xff,
   0x00, 0xff, 0xff, 0xff, 0x07, 0x00, 0x00, 0xff, 0x00, 0x00, 0xe0, 0x3f,
   0xf0, 0xe0, 0x1f, 0x00, 0x3e, 0x00, 0x00, 0x7e, 0xf8, 0xf8, 0xff, 0xff,
   0x3f, 0x00, 0xfc, 0xff, 0xff, 0x07, 0x00, 0x00, 0x7f, 0x00, 0x00, 0xe0,
   0x7f, 0x60, 0xf0, 0x1f, 0x00, 0x00, 0x00, 0x00, 0x00, 0x00, 0x00, 0x00,
   0x00, 0x00, 0x00, 0x00, 0x00, 0x00, 0x00, 0x00, 0x00, 0x00, 0x00, 0x00,
   0xe0, 0xff, 0x60, 0xf0, 0x1f, 0x00, 0x00, 0x00, 0x00, 0x00, 0x00, 0x00,
   0x00, 0x00, 0x00, 0x00, 0x00, 0x00, 0x00, 0x00, 0x00, 0x00, 0x00, 0x00,
   0x00, 0xe0, 0xff, 0x01, 0xf8, 0x1f, 0x00, 0x00, 0x00, 0x00, 0x00, 0x00,
   0x00, 0x00, 0x00, 0x00, 0x00, 0x00, 0x00, 0x00, 0x00, 0x00, 0x00, 0x00,
   0x00, 0x00, 0xe0, 0xff, 0x03, 0xfc, 0x1f, 0x00, 0x00, 0x00, 0x00, 0x00,
   0x00, 0x00, 0x00, 0x00, 0x00, 0x00, 0x00, 0x00, 0x00, 0x00, 0x00, 0x00,
   0x00, 0x00, 0x00, 0xe0, 0xff, 0x03, 0xfc, 0x1f, 0x00, 0x00, 0x00, 0x00,
   0x00, 0x00, 0x00, 0x00, 0x00, 0x00, 0x00, 0x00, 0x00, 0x00, 0x00, 0x00,
   0x00, 0x00, 0x00, 0x00, 0x00, 0x00, 0x00, 0x00, 0x00, 0x00, 0x00, 0x00,
   0x00, 0x00, 0x00, 0x00, 0x00, 0x00, 0x00, 0x00, 0x00, 0x00, 0x00, 0x00,
   0x00, 0x00, 0x00, 0x00, 0x00, 0x00, 0x00, 0x00, 0x00, 0x00, 0x00, 0x00,
   0x00, 0x00, 0x00, 0x00, 0x00, 0x00, 0x00, 0x00, 0x00, 0x00, 0x00, 0x00,
   0x00, 0x00, 0x00, 0x00, 0x00, 0x00, 0x00, 0x00, 0x00, 0x00, 0x00, 0x00,
   0x00, 0x00, 0x00, 0x00, 0x00, 0x00, 0x00, 0x00, 0x00, 0x00, 0x00, 0x00,
   0x00, 0x00, 0x00, 0x00, 0x00, 0x00, 0x00, 0x00, 0x00, 0x00, 0x00, 0x00,
   0x00, 0x00, 0x00, 0x00, 0x00, 0x00, 0x00, 0x00, 0x00, 0x00, 0x00, 0x00,
   0x00, 0x00, 0x00, 0x00, 0x00, 0x00, 0x00, 0x00, 0x00, 0x00, 0x00, 0x00,
   0x00, 0x00, 0x00, 0x00, 0x00, 0x00, 0x00, 0x00, 0x00, 0x00, 0x00, 0x00,
   0x00, 0x00, 0x00, 0x00, 0x00, 0x00, 0x00, 0x00, 0x00, 0x00, 0x00, 0x00,
   0x00, 0x00, 0x00, 0x00, 0x00, 0x00, 0x00, 0x00, 0x00, 0x00, 0x00, 0x00,
   0x00, 0x00, 0x00, 0x00, 0x00, 0x00, 0x00, 0x00, 0x00, 0x00, 0x00, 0x00,
   0x00, 0x00, 0x00, 0x00, 0x00, 0x00, 0x00, 0x00, 0x00, 0x00, 0x00, 0x00,
   0x00, 0x00, 0x00, 0x00, 0x00, 0x00, 0x00, 0x00, 0x00, 0x00, 0x00, 0x00,
   0x00, 0x00, 0x00, 0x00, 0x00, 0x00, 0x00, 0x00, 0x00, 0x00, 0x00, 0x00,
   0x00, 0x00, 0x00, 0x00, 0x00, 0x00, 0x00, 0x00, 0x00, 0x00, 0x00, 0x00,
   0x00, 0x00, 0x00, 0x00, 0x00, 0x00, 0x00, 0x00, 0x00, 0x00, 0x00, 0x00,
   0x00, 0x00, 0x00, 0x00, 0x00, 0x00, 0x00, 0x00, 0x00, 0x00, 0x00, 0x00,
   0x00, 0x00, 0x00, 0x00, 0x00, 0x00, 0x00, 0x00, 0x00, 0x00, 0x00, 0x00,
   0x00, 0x00, 0x00, 0x00, 0x00, 0x00, 0x00, 0x00, 0x00, 0x00, 0x00, 0x00,
   0x00, 0x00, 0x00, 0x00, 0x00, 0x00, 0x00, 0x00, 0x00, 0x00, 0x00, 0x00,
   0x00, 0x00, 0x00, 0x00, 0x00, 0x00, 0x00, 0x00, 0x00, 0x00, 0x00, 0x00,
   0x00, 0x00, 0x00, 0x00, 0x00, 0x00, 0x00, 0x00, 0x00, 0x00, 0x00, 0x00,
   0x00, 0x00, 0x00, 0x00, 0x00, 0x00, 0x00, 0x00, 0x00, 0x00, 0x00, 0x00,
   0x00, 0x00, 0x00, 0x00, 0x00, 0x00, 0x00, 0x00, 0x00, 0x00, 0x00, 0x00,
   0x00, 0x00, 0x00, 0x00, 0x00, 0x00, 0x00, 0x00, 0x00, 0x00, 0x00, 0x00,
   0x00, 0x00, 0x00, 0x00, 0x00, 0x00, 0x00, 0x00, 0x00, 0x00, 0x00, 0x00,
   0x00, 0x00, 0x00, 0x00, 0x00, 0x00, 0x00, 0x00, 0x00, 0x00, 0x00, 0x00,
   0x00, 0x00, 0x00, 0x00, 0x00, 0x00, 0x00, 0x00, 0x00, 0x00, 0x00, 0x00,
   0x00, 0x00, 0x00, 0x00, 0x00, 0x00, 0x00, 0x00, 0x00, 0x00, 0x00, 0x00,
   0x00, 0x00, 0x00, 0x00, 0x00, 0x00, 0x00, 0x00, 0x00, 0x00, 0x00, 0x00,
   0x00, 0x00, 0x00, 0x00, 0x00, 0x00, 0x00, 0x00, 0x00, 0x00, 0x00, 0x00,
   0x00, 0x00, 0x00, 0x00, 0x00, 0x00, 0x00, 0x00, 0x00, 0x00, 0x00, 0x00,
   0x00, 0x00, 0x00, 0x00, 0x00, 0x00, 0x00, 0x00, 0x00, 0x00, 0x00, 0x00,
   0x00, 0x00, 0x00, 0x00, 0x00, 0x00, 0x00, 0x00, 0x00, 0x00, 0x00, 0x00,
   0x00, 0x00, 0x00, 0x00, 0x00, 0x00, 0x00, 0x00, 0x00, 0x00, 0x00, 0x00,
   0x00, 0x00, 0x00, 0x00, 0x00, 0x00, 0x00, 0x00, 0x00, 0x00, 0x00, 0x00,
   0x00, 0x00, 0x00, 0x00, 0x00, 0x00, 0x00, 0x00, 0x00, 0x00, 0x00, 0x00,
   0x00, 0x00, 0x00, 0x00, 0x00, 0x00, 0x00, 0x00, 0x00, 0x00, 0x00, 0x00,
   0x00, 0x00, 0x00, 0x00, 0x00, 0x00, 0x00, 0x00, 0x00, 0x00, 0x00, 0x00,
   0x00, 0x00, 0x00, 0x00, 0x00, 0x00, 0x00, 0x00, 0x00, 0x00, 0x00, 0x00,
   0x00, 0x00, 0x00, 0x00, 0x00, 0x00, 0x00, 0x00, 0x00, 0x00, 0x00, 0x00,
   0x00, 0x00, 0x00, 0x00, 0x00, 0x00, 0x00, 0x00, 0x00, 0x00, 0x00, 0x00,
   0x00, 0x00, 0x00, 0x00, 0x00, 0x00, 0x00, 0x00, 0x00, 0x00, 0x00, 0x00,
   0x00, 0x00, 0x00, 0x00, 0x00, 0x00, 0x00, 0x00, 0x00, 0x00, 0x00, 0x00,
   0x00, 0x00, 0x00, 0x00, 0x00, 0x00, 0x00, 0x00, 0x00, 0x00, 0x00, 0x00,
   0x00, 0x00, 0x00, 0x00, 0x00, 0x00, 0x00, 0x00, 0x00, 0x00, 0x00, 0x00,
   0x00, 0x00, 0x00, 0x00, 0x00, 0x00, 0x00, 0x00, 0x00, 0x00, 0x00, 0x00,
   0x00, 0x00, 0x00, 0x00, 0x00, 0x00, 0x00, 0x00, 0x00, 0x00, 0x00, 0x00,
   0x00, 0x00, 0x00, 0x00, 0x00, 0x00, 0x00, 0x00, 0x00, 0x00, 0x00, 0x00,
   0x00, 0x00, 0x00, 0x00, 0x00, 0x00, 0x00, 0x00, 0x00, 0x00, 0x00, 0x00,
   0x00, 0x00, 0x00, 0x00, 0x00, 0x00, 0x00, 0x00, 0x00, 0x00, 0x00, 0x00,
   0x00, 0x00, 0x00, 0x00, 0x00, 0x00, 0x00, 0x00, 0x00, 0x00, 0x00, 0x00,
   0x00, 0x00, 0x00, 0x00, 0x00, 0x00, 0x00, 0x00, 0x00, 0x00, 0x00, 0x00,
   0x00, 0x00, 0x00, 0x00, 0x00, 0x00, 0x00, 0x00, 0x00, 0x00, 0x00, 0x00,
   0x00, 0x00, 0x00, 0x00, 0x00, 0x00, 0x00, 0x00, 0x00, 0x00, 0x00, 0x00,
   0x00, 0x00, 0x00, 0x00, 0x00, 0x00, 0x00, 0x00, 0x00, 0x00, 0x00, 0x00,
   0x00, 0x00, 0x00, 0x00, 0x00, 0x00, 0x00, 0x00, 0x00, 0x00, 0x00, 0x00,
   0x00, 0x00, 0x00, 0x00, 0x00, 0x00, 0x00, 0x00, 0x00, 0x00, 0x00, 0x00,
   0x00, 0x00, 0x00, 0x00, 0x00, 0x00, 0x00, 0x00, 0x00, 0x00, 0x00, 0x00,
   0x00, 0x00, 0x00, 0x00, 0x00, 0x00, 0x00, 0x00, 0x00, 0x00, 0x00, 0x00,
   0x00, 0x00, 0x00, 0x00, 0x00, 0x00, 0x00, 0x00, 0x00, 0x00, 0x00, 0x00,
   0x00, 0x00, 0x00, 0x00, 0x00, 0x00, 0x00, 0x00, 0x00, 0x00, 0x00, 0x00,
   0x00, 0x00, 0x00, 0x00, 0x00, 0x00, 0x00, 0x00, 0x00, 0x00, 0x00, 0x00,
   0x00, 0x00, 0x00, 0x00, 0x00, 0x00, 0x00, 0x00, 0x00, 0x00, 0x00, 0x00,
   0x00, 0x00, 0x00, 0x00, 0x00, 0x00, 0x00, 0x00, 0x00, 0x00, 0x00, 0x00 };

#endif
```

## src/spi-badge.c
```c
/*
 * Copyright (c) 2017 Antmicro <www.antmicro.com>
 *
 * SPDX-License-Identifier: Apache-2.0
 */

#include <zephyr.h>
#include <string.h>
#include <misc/printk.h>
#include <device.h>
#include <spi.h>
#include "spi-badge.h"

int spi_send_buffer(struct spi_config *spi_conf,
		    unsigned char *data, size_t len)
{
	struct spi_buf tx_buf = {
		.buf = data,
		.len = len,
	};

	int err;

	err = spi_write(spi_conf, &tx_buf, 1);
	if (err != 0) {
		printk("spi_write failed\n");
	}
	return err;
}

int spi_transceive_buffer(struct spi_config *spi_conf,
			unsigned char *tx_data, size_t tx_len,
			unsigned char *rx_data, size_t rx_len)
{
	struct spi_buf tx_buf = {
		.buf = tx_data,
		.len = tx_len,
	};

	struct spi_buf rx_buf = {
		.buf = rx_data,
		.len = rx_len,
	};

	int err;

	err = spi_transceive(spi_conf, &tx_buf, 1, &rx_buf, 1);
	if (err != 0) {
		printk("spi_transceive failed\n");
	}

	return err;
}

void spi_setup_for_epd(struct spi_config *spi_conf)
{
	spi_conf->frequency = 8000000UL;
	spi_conf->operation = (8 << 5); /* 8bit data */
	spi_conf->slave = LCD_CS;
}
```

## src/spi-badge.h
```c
#ifndef __SPI_CONFIG_H__
#define __SPI_CONFIG_H__

#include <zephyr.h>
#include <string.h>
#include <misc/printk.h>
#include <device.h>
#include <spi.h>

#define LCD_CS 2
#define LCD_RESET_OFFSET 0x1 /* gpio 1 */
#define LCD_BUSY_OFFSET 0x0 /* gpio 0 */
#define LCD_DISCHARGE_OFFSET 0xb /* gpio 11 */

#define SPI_WRITE 0x0
#define SPI_READ  0x1

int spi_transceive_buffer(struct spi_config *spi_conf,
			unsigned char *tx_data, size_t tx_len,
			unsigned char *rx_data, size_t rx_len);

int spi_send_buffer(struct spi_config *spi_conf,
		    unsigned char *data, size_t len);

void spi_setup_for_epd(struct spi_config *spi_conf);

#endif
```
